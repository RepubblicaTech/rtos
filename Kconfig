## Kconfig
```kconfig
mainmenu "Project PurpleK2 Kernel"

config ENABLE_64_BIT
    bool "Enable x86_64 support"
    default y
    help
      Enables x86_64 support in the kernel to support the AMD64 architecture

config ENABLE_APIC
    depends on ENABLE_64_BIT
    bool "Enable the APIC"
    default y
    help
      Enables x86_64's Advanced Programmable Interrupt Controller (APIC) support

menu "Filesystems"

config DEVFS_ENABLE
    bool "Enable Device Filesystem (DevFS)"
    default y
    help
      Enable the pseudo filesystem for devices 

menu "DevFS Options"

depends on DEVFS_ENABLE

config DEVFS_MOUNT_PATH
    string "DevFS Mount Path"
    default "/dev"
    help
      Where to mount the DevFS pseudo filesystem

comment "------------------------------"

config DEVFS_ENABLE_NULL
    bool "Enable the 'null' device in the DevFS"
    default y
    help
      Enables the null device, on read it will return zeros (nulls)

config DEVFS_ENABLE_RANDOM
    bool "Enable the 'random' device in the DevFS"
    default y
    help
      Enables the random device, on read it will return random bytes

config DEVFS_ENABLE_PORTIO
    bool "Enable the portio devices (e.g. 'com1')"
    default y
    help
      Enables the portio devices like ('com1', 'lpt1')

config DEVFS_ENABLE_E9
    bool "Enable the E9 port for debugging on Hypervisors (like QEMU)"
    default y
    help
      Enables the E9 hack port device for debugging on Hypervisors

endmenu # DevFS Options

endmenu # Filesystems

menu "Advanced debugging"

config PMM_DEBUG
	bool "Outputs detailed info when PMM allocates/frees a page frame"
	default n
	help
		Enables detailed debugging when calling PMM-related functions

config VMM_DEBUG
	bool "Outputs detailed info when VMM allocates/frees a virtual page"
	default n
	help
		Enables detailed debugging when calling VMM-related functions

config SCHED_DEBUG
	bool "Outputs detailed info about scheduler-related operations"
	default n
	help
		Outputs detailed info about scheduler-related operations
	
endmenu # Advanced debugging
```
